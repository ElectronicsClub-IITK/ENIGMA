/**
 * This is a very small example that shows how to use
 * === OUTPUT COMPARE and INPUT CAPTURE ===
 * The system uses hardware to generate precisely timed
 * pulses, then uses input capture to compare the capture period
 * to the generation period for accuracy
 *
 * There is a capture time print-summary thread
 * There is a one second timer tick thread
 * 
 * On the SECABB:
 * -- Pin RB5 and RB9 are output compare outputs
 * -- Pin RB13 is input capture input -- connect this to one of the output compares
 *
 * Modified by Bruce Land 
 * Jan 2018
 */

////////////////////////////////////
// clock AND protoThreads configure!
// You MUST check this file!
#include <string.h>
#include "config_1_3_2.h"
// threading library
#include "pt_cornell_1_3_2.h"

////////////////////////////////////
// graphics libraries
#include "tft_master.h"
#include "tft_gfx.h"
// need for rand function
#include <stdlib.h>
////////////////////////////////////

// lock out timer interrupt during spi comm to port expander
// This is necessary if you use the SPI2 channel in an ISR
#define start_spi2_critical_section INTEnable(INT_T2, 0);
#define end_spi2_critical_section INTEnable(INT_T2, 1);

//== Timer 2 interrupt handler ===========================================
volatile unsigned int DAC_data_A, DAC_data_B; // output values
volatile SpiChannel spiChn = SPI_CHANNEL2;    // the SPI channel to use
volatile int spiClkDiv = 4;                   // 10 MHz max speed for port expander!!

////////////////////////////////////
// Audio DAC ISR
// A-channel, 1x, active
#define DAC_config_chan_A 0b0011000000000000
// B-channel, 1x, active
#define DAC_config_chan_B 0b1011000000000000
// audio sample frequency
#define Fs 44100.0
// sound length
#define SOUND_N 10992
// enigma sound
const unsigned int sound[SOUND_N] = {2093,2093,2093,2093,2093,2093,2093,2093,2093,2093,2093,2093,2093,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2093

};
unsigned int note_time ;
#define NUM_ROTORS 3;

int A_in_last;
int A_in;
int B_in;
int button;
int button_last;
int counter = 0;

// Rotary encoder
int outputA;
int outputB;
int aState;
int aLastState;

void __ISR(_TIMER_2_VECTOR, ipl2) Timer2Handler(void)
{
  int junk;

  mT2ClearIntFlag();

  DAC_data_A = sound[note_time];
  DAC_data_B = 0;
  if (note_time > SOUND_N){
    note_time = SOUND_N;
  }
  // test for ready
  while (TxBufFullSPI2())
    ;

  // reset spi mode to avoid conflict with expander
  SPI_Mode16();
  // DAC-A CS low to start transaction
  mPORTBClearBits(BIT_4); // start transaction
                          // write to spi2
  WriteSPI2(DAC_config_chan_A | (DAC_data_A & 0xfff));
  note_time++;
  // fold a couple of timer updates into the transmit time
  // test for done
  while (SPI2STATbits.SPIBUSY)
    ; // wait for end of transaction
  // MUST read to clear buffer for port expander elsewhere in code
  junk = ReadSPI2();
  // CS high
  mPORTBSetBits(BIT_4); // end transaction

  // DAC-B CS low to start transaction
  mPORTBClearBits(BIT_4); // start transaction
  // write to spi2
  WriteSPI2(DAC_config_chan_B | (DAC_data_B & 0xfff));
  // test for done
  while (SPI2STATbits.SPIBUSY)
    ; // wait for end of transaction
  // MUST read to clear buffer for port expander elsewhere in code
  junk = ReadSPI2();
  // CS high
  mPORTBSetBits(BIT_4); // end transaction
                        //
}

// === thread structures ============================================
// thread control structs

// note that UART input and output are threads
static struct pt pt_time, pt_sched, pt_encrypt; //, pt_input, pt_output, pt_DMA_output ;

// system 1 second interval tick
int sys_time_seconds;

int NUM_LETTERS = 26;

// Rotors
char rotors[3][26] = {
    "BDFHJLCPRTXVZNYEIWGAKMUSQO",
    "AJDKSIRUXBLHWTMCQGZNPYFVOE",
    "EKMFLGDQVZNTOWYHXUSPAIBRCJ",
};

char test;

int stepping[3];

char reflector[26] = "YRUHQSLDPXNGOKMIEBFZCWVJAT";
// char alphabet[26] = "ABCDEFGHIJKLMNOPQRSTUVWXYZ";
int pairings[64];

// Offsets
volatile int rotor_offsets[3] = {'N' - 'A', 'U' - 'A', 'F' - 'A'};
int turnovers[3] = {'V' - 'A', 'E' - 'A', 'Q' - 'A'};
// int offset_rotor1 = 0;

// Python interface
char new_string = 0;
char new_list = 0;
// String from Python
char receive_string[64] = "\r";
char upper_case[64];
char result[64];
// current listbox
int list_id, list_value;

int encrypt_idx = 0;

// === print a line on TFT =====================================================
// print a line on the TFT
// string buffer
char buffer[60];
void printLine(int line_number, char *print_buffer, short text_color, short back_color)
{
  // line number 0 to 31
  /// !!! assumes tft_setRotation(0);
  // print_buffer is the string to print
  int v_pos;
  v_pos = line_number * 10;
  // erase the pixels
  tft_fillRoundRect(0, v_pos, 239, 8, 1, back_color); // x,y,w,h,radius,color
  tft_setTextColor(text_color);
  tft_setCursor(0, v_pos);
  tft_setTextSize(1);
  tft_writeString(print_buffer);
}

// Convert uppercase
void uppercase_convert(char *input)
{
  int i;
  for (i = 0; input[i] != '\r'; i++)
  {
    if (input[i] >= 'a' && input[i] <= 'z')
    {
      upper_case[i] = input[i] - 32;
    }
    else
    {
      upper_case[i] = input[i];
    }
  }
  upper_case[i] = '\0';
}

int index_inverse(int c, int rotor)
{
  int i = 0;
  while ((rotors[rotor][i] != '\0') && (rotors[rotor][i] != (c + 'A')))
  {
    i++;
  }
  return i;
}

void spin_rotors()
{
  note_time   = 0;
  stepping[0] = 0;
  stepping[1] = 0;
  stepping[2] = 0;
  int i;
  for (i = 2; i > 0; i--)
  {
    if (rotor_offsets[i - 1] == turnovers[i - 1])
    {
      rotor_offsets[i] = (rotor_offsets[i] + 1) % 26;
      stepping[i] = 1;
    }
    if ((rotor_offsets[i] == turnovers[i]) && (stepping[i] == 0))
    {
      if ((i == 2) && stepping[1] == 1)
      {
        rotor_offsets[i] = (rotor_offsets[i] + 1) % 26;
      }
      else if (i == 1)
      {
        rotor_offsets[i] = (rotor_offsets[i] + 1) % 26;
      }
    }
  }
  rotor_offsets[0] = (rotor_offsets[0] + 1) % 26;
}

int char_to_index(char c)
{
  int res = c - 'A';
  return res;
}

int rotor_r_to_l(int input, int rotor)
{
  int idx = (rotor_offsets[rotor] + input) % 26;
  int res = rotors[rotor][idx] - rotor_offsets[rotor] - 'A';
  if (res < 0)
    res += 26;
  else if (res > 25)
    res -= 26;
  return res;
}

int rotor_l_to_r(int input, int rotor)
{
  int idx = (input + rotor_offsets[rotor]) % 26;
  int res = index_inverse(idx, rotor) - rotor_offsets[rotor];
  if (res < 0)
    res += 26;
  else if (res > 25)
    res -= 26;
  return res;
}

int reflect(int input)
{
  return reflector[input] - 'A';
}

void initialize_plugboard()
{
  int i;
  for (i = 0; i < 26; i++)
  {
    pairings[i] = 0;
  }
  i = 0;
  char first;
  char second;
  while (upper_case[i] != '\0'){
    if(upper_case[i] == ' '){
      first = upper_case[i-2] - 'A';
      second = upper_case[i-1] - 'A';
      pairings[first] = second - first;
      pairings[second] = first - second;
    }
    i++;
  }
  first = upper_case[i-2] - 'A';
  second = upper_case[i-1] - 'A';
  pairings[first] = second - first;
  pairings[second] = first - second;
}

int plug_swap(int input)
{
  int offset = pairings[input];
  int res = input + offset;
  return res;
}

// All rotors

// === One second Thread ======================================================
// update a 1 second tick counter
static PT_THREAD(protothread_time(struct pt *pt))
{
  PT_BEGIN(pt);
  static char buffer[128];
  // timer readout
  sprintf(buffer, "%s", "Time in sec since boot\n");
  printLine(0, buffer, ILI9340_WHITE, ILI9340_BLACK);

  // set up LED to blink
  mPORTASetBits(BIT_0);           //Clear bits to ensure light is off.
  mPORTASetPinsDigitalOut(BIT_0); //Set port as output

  while (1)
  {
    // yield time 1 second
    PT_YIELD_TIME_msec(1000);
    sys_time_seconds++;
    // toggle the LED on the big board
    mPORTAToggleBits(BIT_0);
    sprintf(buffer, "%d", sys_time_seconds);
    // printLine(1, buffer, ILI9340_YELLOW, ILI9340_BLACK);
    // printLine(2, receive_string, ILI9340_YELLOW, ILI9340_BLACK);
    printLine(3, upper_case, ILI9340_YELLOW, ILI9340_BLACK);
    sprintf(buffer, "%c    %c    %c", rotor_offsets[2] + 'A', rotor_offsets[1] + 'A', rotor_offsets[0] + 'A');
    printLine(4, buffer, ILI9340_RED, ILI9340_BLACK);
    printLine(5, result, ILI9340_YELLOW, ILI9340_BLACK);
    sprintf(buffer, "%d   %d    %d    %d", A_in, A_in_last, B_in, counter);
    // printLine(6, buffer, ILI9340_YELLOW, ILI9340_BLACK);
    // note_time = 0;
    sprintf(buffer, "%d %d %d %d", pairings[0], pairings[25], pairings[1], pairings[2]);
    // printLine(6, buffer, ILI9340_YELLOW, ILI9340_BLACK);
    // NEVER exit while
  } // END WHILE(1)

  PT_END(pt);
} //

int PT_Encrypt(struct pt *pt)
{
  PT_BEGIN(pt);
  encrypt_idx = 0;
  memset(result, '\0', sizeof(result));
  while (upper_case[encrypt_idx] != '\0')
  {
    int res;
    res = plug_swap(char_to_index(upper_case[encrypt_idx]));
    spin_rotors();
    res = rotor_r_to_l(res, 0);
    res = rotor_r_to_l(res, 1);
    res = rotor_r_to_l(res, 2);
    res = reflect(res);
    res = rotor_l_to_r(res, 2);
    res = rotor_l_to_r(res, 1);
    res = rotor_l_to_r(res, 0);
    res = plug_swap(res);
    result[encrypt_idx] = 'A' + res;
    encrypt_idx++;
    PT_YIELD_TIME_msec(1000);
  }
  // kill this input thread, to allow spawning thread to execute
  PT_EXIT(pt);
  PT_END(pt);
}

// === string input thread =====================================================
// process text from python
static PT_THREAD(protothread_python_string(struct pt *pt))
{
  PT_BEGIN(pt);
  while (1)
  {
    PT_YIELD_UNTIL(pt, new_string == 1);
    new_string = 0;
    uppercase_convert(receive_string + 1);
    // Parse input
    if (receive_string[0] == 'p')
    {
      PT_SPAWN(pt, &pt_encrypt, PT_Encrypt(&pt_encrypt));
    }
    else if (receive_string[0] == 'i')
    {
      memset(rotors[0], '\0', sizeof(rotors[0]));
      strncpy(rotors[0], upper_case, NUM_LETTERS);
    }
    else if (receive_string[0] == 'j')
    {
      memset(rotors[1], '\0', sizeof(rotors[1]));
      strncpy(rotors[1], upper_case, NUM_LETTERS);
    }
    else if (receive_string[0] == 'k')
    {
      memset(rotors[2], '\0', sizeof(rotors[2]));
      strncpy(rotors[2], upper_case, NUM_LETTERS);
    }
    else if (receive_string[0] == 'l')
    {
      initialize_plugboard();
    }
  } // END WHILE(1)
  PT_END(pt);
}

// ===  listbox thread =========================================================
// process listbox from Python to set DDS waveform
static PT_THREAD(protothread_listbox(struct pt *pt))
{
  PT_BEGIN(pt);
  while (1)
  {
    PT_YIELD_UNTIL(pt, new_list == 1);
    // clear flag
    new_list = 0;
    if (list_id == 1)
    {
      rotor_offsets[0] = list_value;
    }
    else if (list_id == 2)
    {
      rotor_offsets[1] = list_value;
    }
    else if (list_id == 3)
    {
      rotor_offsets[2] = list_value;
    }
  } // END WHILE(1)
  PT_END(pt);
} // thread listbox

// === Python serial thread ====================================================
// you should not need to change this thread UNLESS you add new control types
static PT_THREAD(protothread_serial(struct pt *pt))
{
  PT_BEGIN(pt);
  //
  //
  while (1)
  {
    // There is no YIELD in this loop because there are
    // YIELDS in the spawned threads that determine the
    // execution rate while WAITING for machine input
    // =============================================
    // NOTE!! -- to use serial spawned functions
    // you MUST edit config_1_3_2 to
    // (1) uncomment the line -- #define use_uart_serial
    // (2) SET the baud rate to match the PC terminal
    // =============================================

    // now wait for machine input from python
    // Terminate on the usual <enter key>
    PT_terminate_char = '\r';
    PT_terminate_count = 0;
    PT_terminate_time = 0;
    // note that there will NO visual feedback using the following function
    PT_SPAWN(pt, &pt_input, PT_GetMachineBuffer(&pt_input));

    // Parse the string from Python
    // There can be toggle switch, button, slider, and string events

    // string from python input line
    if (PT_term_buffer[0] == '$')
    {
      // output to thread which parses the string
      // while striping off the '$'
      strcpy(receive_string, PT_term_buffer + 1);
      // signal parsing thread
      new_string = 1;
    }
    // listbox
    if (PT_term_buffer[0] == 'l')
    {
      new_list = 1;
      list_id = PT_term_buffer[2] - '0';
      if (PT_term_buffer[4] == '\r')
      {
        list_value = PT_term_buffer[3] - '0';
      }
      else
      {
        list_value = (PT_term_buffer[3] - '0') * 10 + (PT_term_buffer[4] - '0');
      }
      //printf("%d %d", list_id, list_value);
    }
  } // END WHILE(1)
  PT_END(pt);
} // thread blink

static PT_THREAD(protothread_encoder(struct pt *pt))
{
    PT_BEGIN(pt);
    A_in_last = mPORTBReadBits(BIT_7) ? 1 : 0;
    button_last = mPORTBReadBits(BIT_13) ? 1 : 0;
    while(1) {
      // yield time
      PT_YIELD_TIME_msec(10);
      button = mPORTBReadBits(BIT_13) ? 1 : 0;
      if (button == 0 && button_last == 1){
        counter++;
        counter = counter % NUM_ROTORS;
      }
      A_in = mPORTBReadBits(BIT_7) ? 1 : 0;
      if ((A_in == 0) && (A_in_last == 1)){
          B_in = mPORTBReadBits(BIT_8) ? 1 : 0;
          if (B_in != A_in) {
              rotor_offsets[counter] += 1;   
          } else {
              rotor_offsets[counter] -= 1;
          }
          note_time = 0;
          if (rotor_offsets[counter] < 0) rotor_offsets[counter] = 25;
          rotor_offsets[counter] = rotor_offsets[counter] % 26;
      }
      A_in_last = A_in;
      button_last = button;
    }
    PT_END(pt);
} // keypad thread

// === Main  ======================================================

int main(void)
{
  ANSELA = 0;
  ANSELB = 0;

  // set up DAC on big board
  // timer interrupt //////////////////////////
  // Set up timer2 on,  interrupts, internal clock, prescalar 1, toggle rate
  // at 40 MHz PB clock
  // 40,000,000/Fs = 908 : since timer is zero-based, set to 907
  OpenTimer2(T2_ON | T2_SOURCE_INT | T2_PS_1_1, 907);

  // set up the timer interrupt with a priority of 2
  ConfigIntTimer2(T2_INT_ON | T2_INT_PRIOR_2);
  mT2ClearIntFlag(); // and clear the interrupt flag

  // SCK2 is pin 26
  // SDO2 (MOSI) is in PPS output group 2, could be connected to RB5 which is pin 14
  PPSOutput(2, RPB5, SDO2);

  // control CS for DAC
  mPORTBSetPinsDigitalOut(BIT_4);
  mPORTBSetBits(BIT_4);

  // Input for Encoder
  mPORTBSetPinsDigitalIn(BIT_7);
  mPORTBSetPinsDigitalIn(BIT_8);
  mPORTBSetPinsDigitalIn(BIT_13);
  

  // divide Fpb by 2, configure the I/O ports. Not using SS in this example
  // 16 bit transfer CKP=1 CKE=1
  // possibles SPI_OPEN_CKP_HIGH;   SPI_OPEN_SMP_END;  SPI_OPEN_CKE_REV
  // For any given peripherial, you will need to match these
  // clk divider set to 4 for 10 MHz
  SpiChnOpen(SPI_CHANNEL2, SPI_OPEN_ON | SPI_OPEN_MODE16 | SPI_OPEN_MSTEN | SPI_OPEN_CKE_REV, 4);
  // end DAC setup

  // init the display
  tft_init_hw();
  tft_begin();
  tft_fillScreen(ILI9340_BLACK);
  //240x320 vertical display
  tft_setRotation(0); // Use tft_setRotation(1) for 320x240
  tft_setCursor(0, 0);

  // === config the uart, DMA, vref, timer5 ISR ===========
  PT_setup();

  // === setup system wide interrupts  ====================
  INTEnableSystemMultiVectoredInt();

  pt_add(protothread_time, 0);
  pt_add(protothread_serial, 0);
  pt_add(protothread_listbox, 0);
  pt_add(protothread_python_string, 0);
  pt_add(protothread_encoder, 0);

  // === initalize the scheduler ====================
  PT_INIT(&pt_sched);

  pt_sched_method = SCHED_ROUND_ROBIN;

  // === scheduler thread =======================
  // scheduler never exits
  PT_SCHEDULE(protothread_sched(&pt_sched));
  // ============================================
} // main
